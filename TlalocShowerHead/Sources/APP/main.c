/*
 * main implementation: use this 'C' sample to create your own application
 *
 */



/*************************************************************************************************/
/*********************						Includes						**********************/
/*************************************************************************************************/
/* System includes */
#include "derivative.h"
/* Includes used in this file */

/* Own includes */
#include "SensorsControl.h"
#include "SwTimers.h"
#include "InfraredSensors.h"
#include "LCD.h"
#include "GPIODriver.h"
/*************************************************************************************************/
/*********************						Defines							**********************/
/*************************************************************************************************/

/*************************************************************************************************/
/*********************						Typedefs						**********************/
/*************************************************************************************************/

/*************************************************************************************************/
/*********************					Function Prototypes					**********************/
/*************************************************************************************************/

/*************************************************************************************************/
/*********************					Static Variables					**********************/
/*************************************************************************************************/

/*************************************************************************************************/
/*********************					Global Variables					**********************/
/*************************************************************************************************/

/*************************************************************************************************/
/*********************					Static Constants					**********************/
/*************************************************************************************************/

/*************************************************************************************************/
/*********************					Global Constants					**********************/
/*************************************************************************************************/

/*************************************************************************************************/
/*********************						Functions						**********************/
/*************************************************************************************************/


int main(void)
{
	SwTimers_vfnInit();	
	InfraredSensors_vfnInit();
	SensorsControl_vfnInit();
	vfnLCDDriverInit();
	
	
	
	for(;;) 
	{			
		
		SwTimers_vfnTask();		
		SensorsControl_vfnTask();
		InfraredSensors_vfnTask();
		vfnLCDDriver();
		
						
		if(INFRAREDSENSORS_CHECK_UP_EDGE)
		{
			GPIO_TURN_ON_GREEN_LED;
			INFRAREDSENSORS_CLEAR_UP_EDGE;			
			GPIO_WRITE_PIN(C,17,0);			
		}
		
		if(INFRAREDSENSORS_CHECK_DOWN_EDGE)
		{
			GPIO_TURN_ON_BLUE_LED;
			INFRAREDSENSORS_CLEAR_DOWN_EDGE;			
		}		
		
		if(bSensorsControlTimerStatus & (1<<SensorsControlADCTimerStatusFlag))									
			bSensorsControlTimerStatus &= ~(1<<SensorsControlADCTimerStatusFlag);		
		else if(bSensorsControlTimerStatus & (1<<SensorsControlFlowSensorTimerStatusFlag))
		{
			u32 ldwTempVar;			
			ldwTempVar = (dwPulseCounter * 1000)/SENSORSCONTROL_PULSESPERLITER;
			vfnBin32ToASCIIBCD(dwPulseCounter,&baLCDBuffer[0],10,0);
			gbSCFlowSensorStatus = 0;
		}
					
	}
	
	return 0;
}
